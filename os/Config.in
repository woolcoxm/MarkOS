## os/Config.in
```kconfig
menu "MarkOS appliance"
source "$BR2_EXTERNAL_MARKOS_PATH/package/markos-engine/Config.in"
source "$BR2_EXTERNAL_MARKOS_PATH/package/markos-llama/Config.in"
source "$BR2_EXTERNAL_MARKOS_PATH/package/axclhost/Config.in"
source "$BR2_EXTERNAL_MARKOS_PATH/package/axcl-driver/Config.in"
endmenu
```

## os/package/axcl-driver/Config.in
```kconfig
menuconfig BR2_PACKAGE_AXCL_DRIVER
	bool "axcl PCIe host driver (kernel modules)"
	depends on BR2_LINUX_KERNEL
	depends on BR2_aarch64
	help
	  Out-of-tree Axera AXCL PCIe host driver (ax_pcie_host_dev, ax_pcie_msg,
	  ax_pcie_mmb, axcl_host, ax_pcie_p2p_rc) built against the MarkOS
	  kernel. Source: AXERA-TECH's axcl_host aarch64 driver deb (V3.6.2,
	  HF: AXERA-TECH/AXCL) — it ships /usr/src/axcl as a DKMS-style source
	  tree; we drive its kbuild directly with the Buildroot toolchain.

	  Pairing note (int4lab FINDINGS): driver/firmware versions must be
	  compatible with the axclhost runtime; the validated appliance stack
	  is axclhost 3.6.5-m5stack1 + this V3.6.2 driver source + the M5
	  card pac. If a future driver is needed, bump the deb URL + hash.
```

## os/package/axclhost/Config.in
```kconfig
menuconfig BR2_PACKAGE_AXCLHOST
	bool "axclhost (Axera AXCL runtime)"
	depends on BR2_aarch64
	help
	  Axera AXCL host runtime for the M5Stack LLM-8850 / AX8850 M.2
	  accelerator card: libaxcl_rt + friends, card firmware
	  (ax650_card.pac), udev rules and axcl-smi. Sourced from the M5Stack
	  axclhost deb (3.6.5-m5stack1) — driver/firmware pairs must match the
	  card, do not mix vendor builds.

	  The runtime files must be vendored at
	  os/vendor/axclhost-root/ (an unpacked deb root tree). os/build.sh
	  seeds it from Projects/Axera-refs when present; see docs/axera.md
	  for manual placement.

	  https://github.com/woolcoxm/Axera-AX8850-GGUF-Support
```

## os/package/markos-engine/Config.in
```kconfig
menuconfig BR2_PACKAGE_MARKOS_ENGINE
	bool "markos-engine"
	depends on BR2_PACKAGE_HOST_RUSTC_TARGET_ARCH_SUPPORTS
	depends on BR2_TOOLCHAIN_HAS_THREADS
	help
	  MarkOS inference engine: custom serving layer (HTTP/1.1, OpenAI-
	  compatible API, SSE streaming, admin control plane, embedded web UI,
	  memory guardrails, model manager). Tensor backends (pick exactly
	  one): `llama` compiles upstream llama.cpp/ggml for CPU/NEON, `axcl`
	  compiles the Axera fork's ggml-axcl NPU backend for the M5Stack
	  LLM-8850 (AX8850) M.2 card — see docs/axera.md.

	  Host build requirements (enforced by os/build.sh): rustup with the
	  aarch64-unknown-linux-gnu target and host cmake.

if BR2_PACKAGE_MARKOS_ENGINE

choice
	prompt "tensor backend"
	default BR2_PACKAGE_MARKOS_ENGINE_LLAMA

config BR2_PACKAGE_MARKOS_ENGINE_LLAMA
	bool "llama.cpp CPU/NEON (upstream)"
	help
	  Upstream llama.cpp via llama-cpp-2. Any GGUF runs on the CPU.

config BR2_PACKAGE_MARKOS_ENGINE_AXCL
	bool "Axera NPU (ggml-axcl fork)"
	select BR2_PACKAGE_AXCLHOST
	select BR2_PACKAGE_MARKOS_LLAMA
	help
	  The woolcoxm/llama.cpp fork: whole-layer NPU engines with GGUF
	  weight patching when an engine set matches the model's geometry;
	  per-op NPU matmuls or CPU reference otherwise — ANY gguf loads and
	  answers either way.
endchoice

config BR2_PACKAGE_MARKOS_ENGINE_TLS
	bool "enable TLS (rustls) for web UI/API"
	default y
	help
	  Self-signed certificate is generated on first boot; operators can
	  replace cert/key via /data/state/tls.

endif
```

## os/package/markos-llama/Config.in
```kconfig
menuconfig BR2_PACKAGE_MARKOS_LLAMA
	bool "markos-llama (Axera llama.cpp fork source)"
	help
	  Source-only package: a pinned checkout of woolcoxm/llama.cpp branch
	  axera-any-gguf (llama.cpp + the ggml-axcl NPU backend that runs GGUF
	  weights directly on the AX8850). markos-engine's `axcl` feature
	  compiles it through cmake (GGML_AXCL=ON) via markos-llama-sys.

	  The commit must be pushed to GitHub for a fresh build machine to
	  fetch it; bump MARKOS_LLAMA_VERSION when moving the pin.
```
